## arch/arm64/configs/fleur_defconfig
```kconfig
CONFIG_TOOLS_SUPPORT_RELR=y
CONFIG_PREEMPT=y
CONFIG_LOG_BUF_SHIFT=21
CONFIG_EROFS_FS=y
CONFIG_EROFS_FS_PCPU_KTHREAD=y
CONFIG_EROFS_FS_PCPU_KTHREAD_HIPRI=y
CONFIG_UCLAMP_TASK=y
CONFIG_UCLAMP_TASK_GROUP=y
CONFIG_CPUSETS=y
# CONFIG_RD_BZIP2 is not set
# CONFIG_RD_LZMA is not set
# CONFIG_RD_XZ is not set
# CONFIG_RD_LZO is not set
# CONFIG_RD_LZ4 is not set
CONFIG_SYSCTL_SYSCALL=y
# CONFIG_FHANDLE is not set
CONFIG_KALLSYMS_ALL=y
# CONFIG_KALLSYMS_BASE_RELATIVE is not set
# CONFIG_SLUB_DEBUG is not set
CONFIG_ARCH_MEDIATEK=y
CONFIG_MACH_MT6781=y
CONFIG_SCHED_MC=y
CONFIG_NR_CPUS=8
CONFIG_ARM64_DMA_USE_IOMMU=y
CONFIG_RANDOMIZE_BASE=y
CONFIG_CMDLINE="root=/dev/ram vmalloc=496M slub_max_order=0 slub_debug=- ramoops_memreserve=4M"
# CONFIG_EFI is not set
CONFIG_BUILD_ARM64_APPENDED_DTB_IMAGE=y
CONFIG_BUILD_ARM64_APPENDED_DTB_IMAGE_NAMES="mediatek/mt6781"
CONFIG_BUILD_ARM64_DTB_OVERLAY_IMAGE=y
CONFIG_BUILD_ARM64_DTB_OVERLAY_IMAGE_NAMES="mediatek/fleur"
CONFIG_WQ_POWER_EFFICIENT_DEFAULT=y
CONFIG_ENERGY_MODEL=y
CONFIG_CPU_FREQ=y
CONFIG_CPU_FREQ_STAT=y
CONFIG_CPU_FREQ_DEFAULT_GOV_SCHEDUTIL=y
CONFIG_CPU_FREQ_GOV_POWERSAVE=y
CONFIG_CPU_FREQ_GOV_USERSPACE=y
CONFIG_CPU_FREQ_GOV_ONDEMAND=y
CONFIG_KPROBES=y
CONFIG_MODULE_SRCVERSION_ALL=y
# CONFIG_BLK_DEV_BSG is not set
CONFIG_BLK_INLINE_ENCRYPTION=y
CONFIG_BLK_INLINE_ENCRYPTION_FALLBACK=y
# CONFIG_CORE_DUMP_DEFAULT_ELF_HEADERS is not set
CONFIG_ZSMALLOC=y
CONFIG_XFRM_MIGRATE=y
CONFIG_SYN_COOKIES=y
CONFIG_VLAN_8021Q=y
CONFIG_CLS_U32_PERF=y
CONFIG_CLS_U32_MARK=y
CONFIG_CFG80211=y
# CONFIG_CFG80211_DEFAULT_PS is not set
# CONFIG_UEVENT_HELPER is not set
CONFIG_FW_LOADER_USER_HELPER=y
CONFIG_FW_LOADER_USER_HELPER_FALLBACK=y
# CONFIG_FW_CACHE is not set
CONFIG_ZRAM=y
CONFIG_BLK_DEV_LOOP_MIN_COUNT=16
CONFIG_ANDROID_DEFAULT_SETTING=y
CONFIG_MTK_ANDROID_DEFAULT_SETTING=y
CONFIG_USB_MTK_HDRC=y
CONFIG_MTK_MUSB_QMU_SUPPORT=y
CONFIG_MTK_MUSB_QMU_PURE_ZLP_SUPPORT=y
CONFIG_MTK_MUSB_DRV_36BIT=y
CONFIG_USB_MTK_OTG=y
CONFIG_MTK_MUSB_DUAL_ROLE=y
CONFIG_MTK_PLATFORM="mt6785"
CONFIG_ARCH_MTK_PROJECT="fleur"
CONFIG_BLK_CGROUP=y
CONFIG_MTK_BATTERY_OC_POWER_THROTTLING=y
CONFIG_MTK_BATTERY_PERCENTAGE_POWER_THROTTLING=y
CONFIG_MTK_LOW_BATTERY_POWER_THROTTLING=y
CONFIG_MTK_DYNAMIC_LOADING_POWER_THROTTLING=y
CONFIG_MTK_PTPOD=y
CONFIG_MTK_STATIC_POWER=y
CONFIG_MTK_UNIFY_POWER=y
CONFIG_MTK_CPU_FREQ=y
CONFIG_MTK_PBM=y
CONFIG_MTK_PMIC_NEW_ARCH=y
CONFIG_MTK_PMIC_COMMON=y
CONFIG_MTK_PMIC_CHIP_MT6358=y
CONFIG_MTK_EXTERNAL_CHARGER_TYPE_DETECT=y
CONFIG_MFD_MT6370_PMU=y
#CONFIG_MT6370_PMU_CHARGER is not set
CONFIG_MT6370_PMU_FLED=y
CONFIG_MT6370_PMU_BLED=y
CONFIG_MT6370_PMU_LDO=y
CONFIG_MT6370_PMU_DSV=y
CONFIG_MTK_PMIC_WRAP_HAL=y
CONFIG_CUSTOM_KERNEL_IMGSENSOR="s5khm2sd_main_ofilm_mipi_raw s5khm2sd_main_semco_mipi_raw ov64b40_main_sunny_mipi_raw ov64b40_main_aac_mipi_raw ov64b40_main_ofilm_mipi_raw imx471_front_sunny_mipi_raw imx471_front_ofilm_mipi_raw imx355_ultra_ofilm_mipi_raw s5k4h7_ultra_sunny_mipi_raw ov02b1b_depth_sunny_mipi_raw ov02b1b_depth_truly_mipi_raw ov02b1b_depth_sunny2_mipi_raw gc02m1_macro_ofilm_mipi_raw gc02m1_macro_aac_mipi_raw"
CONFIG_CUSTOM_KERNEL_CAM_CAL_DRV="BRCB032GWZ_3 GT24c32a cat24c16"
CONFIG_MTK_SYNC=y
CONFIG_MTK_LCM_PHYSICAL_ROTATION="0"
CONFIG_MTK_ROUND_CORNER_SUPPORT=y
CONFIG_LCM_HEIGHT="2400"
CONFIG_LCM_WIDTH="1080"
CONFIG_LEDS_MTK_DISP=y
CONFIG_BACKLIGHT_SUPPORT_2047_FEATURE=y
CONFIG_MTK_VDEC_FMT=y
CONFIG_MTK_PSEUDO_M4U=y
CONFIG_MTK_FLASHLIGHT=y
CONFIG_MTK_FLASHLIGHT_OCP8132=y
CONFIG_MTK_FLASHLIGHT_PT=y
CONFIG_MTK_FLASHLIGHT_PT_STRICT=y
CONFIG_MTK_FLASHLIGHT_DLPT=y
CONFIG_RT_FLASHLIGHT=y
CONFIG_MTK_IMGSENSOR=y
CONFIG_MTK_LENS=y
CONFIG_MTK_CAM_CAL=y
CONFIG_MTK_CMDQ=y
CONFIG_MTK_CMDQ_MBOX_EXT=y
CONFIG_MTK_SMI_EXT=y
CONFIG_MTK_CAM_SECURITY_SUPPORT=y
CONFIG_MTK_CAM_GENIEZONE_SUPPORT=y
CONFIG_MTK_SENSOR_SUPPORT=y
CONFIG_MTK_SENSOR_ARCHITECTURE="1.0"
CONFIG_CUSTOM_KERNEL_ACCELEROMETER=y
CONFIG_MTK_SAR_HUB=y
CONFIG_MTK_ACCELHUB=y
CONFIG_CUSTOM_KERNEL_ALSPS=y
CONFIG_MTK_ALSPSHUB=y
CONFIG_CUSTOM_KERNEL_GYROSCOPE=y
CONFIG_MTK_GYROHUB=y
CONFIG_CUSTOM_KERNEL_MAGNETOMETER=y
CONFIG_MTK_MAGHUB=y
CONFIG_MTK_HWMON=y
CONFIG_CUSTOM_KERNEL_BAROMETER=y
CONFIG_MTK_BAROHUB=y
CONFIG_CUSTOM_KERNEL_STEP_COUNTER=y
CONFIG_MTK_STEPSIGNHUB=y
CONFIG_CUSTOM_KERNEL_SITUATION=y
CONFIG_MTK_WAKEHUB=y
CONFIG_MTK_DEVICE_ORIENTATION_HUB=y
CONFIG_MTK_MOTION_DETECT_HUB=y
CONFIG_MTK_TILTDETECTHUB=y
CONFIG_MTK_PICKUPHUB=y
CONFIG_CUSTOM_KERNEL_SENSORHUB=y
CONFIG_NANOHUB=y
CONFIG_NANOHUB_MTK_IPI=y
CONFIG_CUSTOM_KERNEL_SENSOR_FUSION=y
CONFIG_CUSTOM_KERNEL_GRV_SENSOR=y
CONFIG_CUSTOM_KERNEL_GMRV_SENSOR=y
CONFIG_CUSTOM_KERNEL_RV_SENSOR=y
CONFIG_CUSTOM_KERNEL_LINEARACCEL_SENSOR=y
CONFIG_CUSTOM_KERNEL_GRAVITY_SENSOR=y
CONFIG_CUSTOM_KERNEL_UNCALI_ACC_SENSOR=y
CONFIG_CUSTOM_KERNEL_UNCALI_GYRO_SENSOR=y
CONFIG_CUSTOM_KERNEL_UNCALI_MAG_SENSOR=y
CONFIG_CUSTOM_KERNEL_SENSOR_CAL=y
CONFIG_MTK_UNCALI_MAGHUB=y
CONFIG_MTK_UNCALI_GYROHUB=y
CONFIG_MTK_UNCALI_ACCHUB=y
CONFIG_MTK_CCCI_DEVICES=y
CONFIG_MTK_MD1_SUPPORT=11
CONFIG_MTK_ECCCI_DRIVER=y
CONFIG_MTK_ECCCI_C2K=y
CONFIG_MTK_BTIF=y
CONFIG_MTK_COMBO=y
CONFIG_MTK_COMBO_CHIP_CONSYS_6781=y
CONFIG_MTK_COMBO_BT=y
CONFIG_MTK_COMBO_GPS=y
CONFIG_MTK_COMBO_WIFI=y
CONFIG_MTK_DHCPV6C_WIFI=y
CONFIG_MTK_GPS_SUPPORT=y
CONFIG_MTK_GPS_EMI=y
CONFIG_MTK_FMRADIO=y
CONFIG_MTK_FM_CHIP="MT6631_FM"
CONFIG_MTK_CONNFEM=y
CONFIG_MTK_CONNSYS_DEDICATED_LOG_PATH=y
CONFIG_WLAN_DRV_BUILD_IN=y
CONFIG_HAVE_MTK_ENABLE_GENIEZONE=y
CONFIG_MTK_ENABLE_GENIEZONE=y
CONFIG_MTK_GZ_MAIN=y
CONFIG_MTK_GZ_LOG=y
CONFIG_MTK_GZ_VIRTIO=y
CONFIG_MTK_GZ_VIRTIO_IPC=y
CONFIG_MTK_GZ_IRQ=y
CONFIG_HAVE_MTK_GZ_LOG=y
CONFIG_EXTCON_MTK_USB=y
#CONFIG_MTK_USB_TYPEC_U3_MUX is not set
CONFIG_TCPC_CLASS=y
#CONFIG_TCPC_MT6370 is not set
CONFIG_TCPC_RT1711H=y
CONFIG_USB_POWER_DELIVERY=y
CONFIG_MTK_LEDS=y
CONFIG_LEDS_MTK_PWM=y
CONFIG_MTK_PWM=y
CONFIG_MTK_AUDIODSP_SUPPORT=y
CONFIG_MTK_ACCDET=y
CONFIG_ACCDET_EINT_IRQ=y
CONFIG_ACCDET_SUPPORT_EINT0=y
CONFIG_MTK_RTC=y
CONFIG_MTK_TINYSYS_SCP_SUPPORT=y
CONFIG_MTK_TINYSYS_SSPM_SUPPORT=y
CONFIG_MTK_TINYSYS_SSPM_V2=y
CONFIG_MTK_CM_MGR_LEGACY=y
CONFIG_MTK_LEGACY_THERMAL=y
CONFIG_MTK_THERMAL_PA_VIA_ATCMD=y
CONFIG_MTK_CAMERA_ISP_RSC_SUPPORT=y
CONFIG_MTK_CAMERA_ISP_MFB_SUPPORT=y
CONFIG_MTK_CAMERA_ISP_FD_SUPPORT=y
CONFIG_MTK_DRAM_LOG_STORE=y
CONFIG_MTK_DRAM_LOG_STORE_ADDR=0x0011DF00
CONFIG_MTK_DRAM_LOG_STORE_SIZE=0x100
CONFIG_MTK_FREQ_HOPPING=y
CONFIG_MEMORY_STATE_TIME=y
CONFIG_SCSI=y
CONFIG_BLK_DEV_SD=y
CONFIG_SCSI_SCAN_ASYNC=y
CONFIG_SCSI_UFSHCD=y
CONFIG_SCSI_UFSHCD_PLATFORM=y
CONFIG_SCSI_UFS_HPB=y
CONFIG_SCSI_UFS_MEDIATEK=y
CONFIG_SCSI_UFS_FEATURE=y
CONFIG_SCSI_UFS_TW=y
CONFIG_SCSI_UFS_CRYPTO=y
CONFIG_DM_CRYPT=y
CONFIG_DM_DEFAULT_KEY=y
CONFIG_DM_UEVENT=y
CONFIG_DM_VERITY_FEC=y
CONFIG_IFB=y
# CONFIG_ETHERNET is not set
CONFIG_WIREGUARD=y
CONFIG_PPP_FILTER=y
CONFIG_PPP_MULTILINK=y
CONFIG_PPPOE=y
CONFIG_PPP_ASYNC=y
CONFIG_PPP_SYNC_TTY=y
CONFIG_USB_USBNET=y
# CONFIG_KEYBOARD_ATKBD is not set
CONFIG_KEYBOARD_MTK=y
CONFIG_ONEKEY_REBOOT_NORMAL_MODE=y
CONFIG_ONEKEY_REBOOT_OTHER_MODE=y
CONFIG_KPD_PWRKEY_USE_PMIC=y
# CONFIG_INPUT_MOUSE is not set
CONFIG_INPUT_TOUCHSCREEN=y
CONFIG_TOUCHSCREEN_MTK=y
CONFIG_TOUCHSCREEN_FTS=y
CONFIG_TOUCHSCREEN_COMMON=y
CONFIG_INPUT_MISC=y
CONFIG_INPUT_UINPUT=y
CONFIG_FINGERPRINT_SUPPORT=y
CONFIG_FPC_FINGERPRINT=y
CONFIG_GOODIX_FINGERPRINT=y
# CONFIG_SERIO is not set
# CONFIG_VT is not set
CONFIG_LEGACY_PTY_COUNT=16
# CONFIG_DEVMEM is not set
CONFIG_SERIAL_8250=y
CONFIG_SERIAL_8250_CONSOLE=y
CONFIG_SERIAL_8250_NR_UARTS=2
CONFIG_SERIAL_8250_RUNTIME_UARTS=2
CONFIG_SERIAL_8250_MT6577=y
CONFIG_I2C_MTK=y
CONFIG_SPI=y
CONFIG_SPI_MT65XX=y
CONFIG_MTK_CHARGER=y
CONFIG_MTK_KERNEL_POWER_OFF_CHARGING=y
CONFIG_MTK_GAUGE_VERSION=30
# CONFIG_HWMON is not set
CONFIG_THERMAL=y
CONFIG_THERMAL_DEFAULT_GOV_BACKWARD_COMPATIBLE=y
CONFIG_WATCHDOG=y
CONFIG_MEDIATEK_WATCHDOG=y
CONFIG_MFD_MT6358=y
CONFIG_MT6358_MISC=y
CONFIG_REGULATOR_MT6358=y
CONFIG_REGULATOR_RT5133=y
CONFIG_MEDIA_SUPPORT=y
CONFIG_MEDIA_CAMERA_SUPPORT=y
CONFIG_V4L_PLATFORM_DRIVERS=y
CONFIG_V4L_MEM2MEM_DRIVERS=y
CONFIG_VIDEO_MEDIATEK_JPEG=y
CONFIG_VIDEO_MEDIATEK_VCODEC=y
CONFIG_DRM=y
CONFIG_DRM_DSI_PANEL_K7S_38_0C_0A_VIDEO=y
CONFIG_DRM_DSI_PANEL_K7S_38_0C_0B_VIDEO=y
CONFIG_DRM_MEDIATEK=y
CONFIG_MTK_GPU_SUPPORT=y
CONFIG_MTK_GPU_VERSION="mali valhall r32p1"
CONFIG_MTK_GPU_COMMON_DVFS_SUPPORT=y
CONFIG_FB_MODE_HELPERS=y
CONFIG_FB_TILEBLITTING=y
CONFIG_BACKLIGHT_LCD_SUPPORT=y
CONFIG_BACKLIGHT_CLASS_DEVICE=y
CONFIG_LOGO=y
CONFIG_SND_DYNAMIC_MINORS=y
# CONFIG_SND_SPI is not set
CONFIG_SND_USB_AUDIO=y
CONFIG_SND_SOC=y
CONFIG_SND_SOC_MT6781_MT6366=y
CONFIG_SND_SOC_MTK_BTCVSD=y
CONFIG_SND_SOC_MTK_AUDIO_DSP=y
CONFIG_SND_SOC_MT6660=y
CONFIG_HIDRAW=y
CONFIG_HID_A4TECH=y
CONFIG_HID_APPLE=y
CONFIG_HID_BELKIN=y
CONFIG_HID_CHERRY=y
CONFIG_HID_CHICONY=y
CONFIG_HID_CYPRESS=y
CONFIG_HID_DRAGONRISE=y
CONFIG_HID_EZKEY=y
CONFIG_HID_KYE=y
CONFIG_HID_GYRATION=y
CONFIG_HID_TWINHAN=y
CONFIG_HID_KENSINGTON=y
CONFIG_HID_LOGITECH=y
CONFIG_HID_MAGICMOUSE=y
CONFIG_HID_MICROSOFT=y
CONFIG_HID_MONTEREY=y
CONFIG_HID_PANTHERLORD=y
CONFIG_HID_PETALYNX=y
CONFIG_HID_SAMSUNG=y
CONFIG_HID_SUNPLUS=y
CONFIG_HID_GREENASIA=y
CONFIG_HID_SMARTJOYPLUS=y
CONFIG_HID_TOPSEED=y
CONFIG_HID_THRUSTMASTER=y
CONFIG_HID_ZEROPLUS=y
CONFIG_USB_STORAGE=y
CONFIG_USB_STORAGE_DATAFAB=y
CONFIG_USB_STORAGE_FREECOM=y
CONFIG_USB_STORAGE_ISD200=y
CONFIG_USB_STORAGE_USBAT=y
CONFIG_USB_STORAGE_SDDR09=y
CONFIG_USB_STORAGE_SDDR55=y
CONFIG_USB_STORAGE_JUMPSHOT=y
CONFIG_USB_STORAGE_ALAUDA=y
CONFIG_USB_STORAGE_ONETOUCH=y
CONFIG_USB_STORAGE_KARMA=y
CONFIG_USB_STORAGE_CYPRESS_ATACB=y
CONFIG_USB_TRANCEVIBRATOR=y
CONFIG_NOP_USB_XCEIV=y
CONFIG_USB_GADGET_VBUS_DRAW=500
CONFIG_USB_CONFIGFS_SERIAL=y
CONFIG_USB_CONFIGFS_ACM=y
CONFIG_USB_CONFIGFS_RNDIS=y
CONFIG_USB_CONFIGFS_MASS_STORAGE=y
CONFIG_USB_CONFIGFS_MTK_FASTMETA=y
CONFIG_USB_CONFIGFS_F_HID=y
CONFIG_USB_CONFIGFS_F_UVC=y
CONFIG_USB_CONFIGFS_NCM=y
CONFIG_MMC=y
CONFIG_MMC_BLOCK_MINORS=32
CONFIG_MMC_CRYPTO=y
CONFIG_MTK_EMMC_SUPPORT_OTP=y
CONFIG_MMC_CQHCI=y
CONFIG_MMC_MTK=y
CONFIG_NEW_LEDS=y
CONFIG_LEDS_CLASS=y
CONFIG_LEDS_TRIGGERS=y
CONFIG_LEDS_TRIGGER_TIMER=y
CONFIG_AW8622_HAPTIC=y
# CONFIG_RTC_SYSTOHC is not set
CONFIG_RTC_DRV_MT6358=y
CONFIG_DMADEVICES=y
CONFIG_MTK_UART_APDMA=y
CONFIG_ANDROID_INTF_ALARM_DEV=y
CONFIG_ION=y
CONFIG_MTK_ION=y
CONFIG_MTK_IOMMU_V2=y
CONFIG_MTK_IOMMU_PGTABLE_EXT=34
CONFIG_RPMSG_MTK=y
CONFIG_MTK_PMIC_WRAP=y
CONFIG_MTK_IPI=y
CONFIG_MTK_MBOX=y
CONFIG_MTK_ULTRASND_PROXIMITY=y
CONFIG_MTK_TINYSYS_SCP_CM4_SUPPORT=y
CONFIG_IIO=y
CONFIG_IIO_BUFFER=y
CONFIG_IIO_KFIFO_BUF=y
CONFIG_MEDIATEK_MT6577_AUXADC=y
CONFIG_MT635X_AUXADC=y
CONFIG_PWM=y
CONFIG_PWM_MTK_DISP=y
CONFIG_PHY_MTK_TPHY=y
CONFIG_MTK_DEVINFO=y
CONFIG_FS_ENCRYPTION_INLINE_CRYPT=y
CONFIG_QUOTA_NETLINK_INTERFACE=y
CONFIG_INCREMENTAL_FS=y
CONFIG_ISO9660_FS=y
CONFIG_JOLIET=y
CONFIG_ZISOFS=y
CONFIG_MSDOS_FS=y
CONFIG_VFAT_FS=y
CONFIG_PSTORE=y
CONFIG_PSTORE_CONSOLE=y
CONFIG_PSTORE_PMSG=y
CONFIG_PSTORE_RAM=y
# CONFIG_NETWORK_FILESYSTEMS is not set
CONFIG_NLS_CODEPAGE_437=y
CONFIG_NLS_CODEPAGE_950=y
CONFIG_NLS_ASCII=y
CONFIG_NLS_ISO8859_1=y
CONFIG_NLS_UTF8=y
CONFIG_STATIC_USERMODEHELPER=y
CONFIG_STATIC_USERMODEHELPER_PATH=""
CONFIG_SECURITY_SELINUX_DEVELOP=y
CONFIG_CRYPTO_TWOFISH=y
CONFIG_CRYPTO_BLAKE2B=y
# CONFIG_CRYPTO_HW is not set
CONFIG_PRINTK_TIME=y
CONFIG_FRAME_WARN=2800
CONFIG_DETECT_HUNG_TASK=y
CONFIG_BOOTPARAM_HUNG_TASK_PANIC=y
# CONFIG_PANIC_ON_OOPS is not set
CONFIG_PANIC_TIMEOUT=1
CONFIG_SCHEDSTATS=y
# CONFIG_DEBUG_PREEMPT is not set
# CONFIG_DEBUG_BUGVERBOSE is not set
CONFIG_RCU_CPU_STALL_TIMEOUT=60
CONFIG_FAULT_INJECTION=y
CONFIG_BQ2597X_CHARGE_PUMP=y
CONFIG_BATT_VERIFY=y
CONFIG_ONEWIRE_GPIO=y
CONFIG_BATT_VERIFY_BY_DS28E16=y
CONFIG_CHARGER_BQ2589X=y
CONFIG_SPI_SPIDEV=y
CONFIG_CPU_THERMAL=y
CONFIG_SND_SOC_FS18XX=y
CONFIG_SND_SOC_SIA81XX=y
CONFIG_I2C_CHARDEV=y
CONFIG_SND_SOC_DSPK_LOL_HP=y
CONFIG_SND_SOC_AW87XXX=y
CONFIG_NFC_CHIP_SUPPORT=y
CONFIG_MTK_NFC_CLKBUF_ENABLE=y
CONFIG_MICROTRUST_TEE_SUPPORT=y
CONFIG_TEE=y
CONFIG_SIMTRAY_STATUS=y
CONFIG_MTK_SEC_VIDEO_PATH_SUPPORT=y
CONFIG_DRM_KEY_MNG_SUPPORT=y
CONFIG_MTK_TEE_GP_SUPPORT=y
CONFIG_MTK_SVP_ON_MTEE_SUPPORT=y
CONFIG_CMDLINE_EXTEND=y
CONFIG_MI_FS=y
CONFIG_EXFAT_FS=y
CONFIG_EXFAT_DISCARD=y
CONFIG_EXFAT_DEFAULT_CODEPAGE=437
CONFIG_EXFAT_DEFAULT_IOCHARSET="utf8"
CONFIG_ANT_CHECK=y

# LTO
CONFIG_INLINE_OPTIMIZATION=y
CONFIG_LTO=y
CONFIG_LTO_CLANG=y
CONFIG_ARCH_SUPPORTS_LTO_CLANG=y
CONFIG_ARCH_SUPPORTS_THINLTO=y
# CONFIG_LTO_NONE is not set
# CONFIG_LTO_CLANG_FULL is not set
CONFIG_THINLTO=y

# Enable F2FS Compression
CONFIG_F2FS_FS_COMPRESSION=y

# Enable memory leak detection if necessary
CONFIG_SLABINFO=n
CONFIG_DEBUG_FS=n
CONFIG_PROC_KCORE=n
CONFIG_PROC_PAGE_MONITOR=n
CONFIG_PAGE_EXTENSION=n
CONFIG_SLUB_DEBUG=n
CONFIG_SLUB_DEBUG_ON=n

# Directly / Indirectly impacts auto brightness / adaptive brightness and faster GPS location
CONFIG_MTK_AAL_SUPPORT=y
CONFIG_AUDIT=y
CONFIG_AUDITSYSCALL=y
CONFIG_AUDIT_TREE=y
CONFIG_AUDIT_WATCH=y
CONFIG_IKCONFIG=y
CONFIG_IKCONFIG_PROC=y

# Ultrasonic Proximity Sensor
CONFIG_NET_ACT_MIRRED=y
CONFIG_NET_CLS_ACT=y
CONFIG_NET_CLS_BPF=y
CONFIG_NET_EMATCH=y
CONFIG_CGROUP_RDMA=y

# Mediatek DRM
CONFIG_TRACING=y
CONFIG_EVENT_TRACING=y
CONFIG_PRINTK_TIME=y
CONFIG_FUNCTION_TRACER=y
CONFIG_DEBUG_FS=y

# Compressing
CONFIG_PSTORE_DEFLATE_COMPRESS=y
CONFIG_PSTORE_LZO_COMPRESS=y
CONFIG_PSTORE_LZ4_COMPRESS=y
CONFIG_PSTORE_LZ4HC_COMPRESS=y
CONFIG_PSTORE_ZSTD_COMPRESS=y
CONFIG_PSTORE_COMPRESS=y
CONFIG_PSTORE_COMPRESS_DEFAULT=y
CONFIG_PSTORE_COMPRESS_NONE=y

# START Modules not needed
# Debugging & Tracing
CONFIG_ENABLE_DEFAULT_TRACERS=n
CONFIG_FTRACE=n
CONFIG_KPROBE_EVENTS=n
CONFIG_UPROBE_EVENTS=n
CONFIG_BPF_EVENTS=n
CONFIG_FUNCTION_GRAPH_TRACER=n
CONFIG_STACK_TRACER=n
CONFIG_DYNAMIC_FTRACE=n
CONFIG_DEBUG_KERNEL=n
CONFIG_DEBUG_INFO=n
CONFIG_DEBUG_LIST=n
CONFIG_DEBUG_SPINLOCK=n
CONFIG_DEBUG_MUTEXES=n
CONFIG_DEBUG_ATOMIC_SLEEP=n
CONFIG_DEBUG_PREEMPT=n
CONFIG_DEBUG_LOCK_ALLOC=n
CONFIG_DEBUG_VM=n
CONFIG_DEBUG_MEMORY_INIT=n
CONFIG_DEBUG_PER_CPU_MAPS=n
CONFIG_DEBUG_OBJECTS=n
CONFIG_DEBUG_OBJECTS_TIMERS=n
CONFIG_DEBUG_OBJECTS_WORK=n
CONFIG_DEBUG_OBJECTS_RCU_HEAD=n
CONFIG_DEBUG_OBJECTS_PERCPU_COUNTER=n
CONFIG_DEBUG_SG=n
CONFIG_DEBUG_NOTIFIERS=n
CONFIG_DEBUG_CREDENTIALS=n
CONFIG_DEBUG_FORCE_WEAK_PER_CPU=n
CONFIG_DEBUG_KMEMLEAK=n
CONFIG_DEBUG_KMEMLEAK_AUTO_SCAN=n
CONFIG_DEBUG_KMEMLEAK_DEFAULT_OFF=n
CONFIG_DEBUG_STACK_USAGE=n
CONFIG_DEBUG_STACKOVERFLOW=n
CONFIG_DEBUG_BUGVERBOSE=n
CONFIG_DEBUG_INFO_REDUCED=n
CONFIG_DEBUG_INFO_DWARF4=n
CONFIG_DEBUG_INFO_BTF=n
CONFIG_DEBUG_INFO_SPLIT=n
CONFIG_DEBUG_INFO_COMPRESSED=n
CONFIG_DEBUG_INFO_NONE=n
CONFIG_DEBUG_MISC=n
CONFIG_DEBUG_DEVRES=n
CONFIG_DEBUG_DRIVER=n
CONFIG_DEBUG_IRQFLAGS=n
CONFIG_DEBUG_LOCKING_API_SELFTESTS=n
CONFIG_DEBUG_SHIRQ=n
CONFIG_DEBUG_TLBFLUSH=n
CONFIG_DEBUG_PAGEALLOC=n
CONFIG_DEBUG_OBJECTS_ENABLE=n
CONFIG_DEBUG_OBJECTS_FREE=n
CONFIG_DEBUG_OBJECTS_INIT=n
CONFIG_DEBUG_OBJECTS_CHECK=n
CONFIG_DEBUG_OBJECTS_USE=n
CONFIG_DEBUG_OBJECTS_USE_STATIC=n
CONFIG_DEBUG_OBJECTS_USE_DYNAMIC=n
CONFIG_DEBUG_OBJECTS_USE_DYNAMIC_ALLOC=n
CONFIG_DEBUG_OBJECTS_USE_DYNAMIC_FREE=n
CONFIG_DEBUG_OBJECTS_USE_DYNAMIC_INIT=n
CONFIG_DEBUG_OBJECTS_USE_DYNAMIC_CHECK=n
CONFIG_DEBUG_OBJECTS_USE_DYNAMIC_USE=n
CONFIG_DEBUG_OBJECTS_USE_DYNAMIC_USE_STATIC=n
CONFIG_DEBUG_OBJECTS_USE_DYNAMIC_USE_DYNAMIC=n
CONFIG_DEBUG_OBJECTS_USE_DYNAMIC_USE_DYNAMIC_ALLOC=n
CONFIG_DEBUG_OBJECTS_USE_DYNAMIC_USE_DYNAMIC_FREE=n
CONFIG_DEBUG_OBJECTS_USE_DYNAMIC_USE_DYNAMIC_INIT=n
CONFIG_DEBUG_OBJECTS_USE_DYNAMIC_USE_DYNAMIC_CHECK=n
CONFIG_DEBUG_OBJECTS_USE_DYNAMIC_USE_DYNAMIC_USE=n

# Kernel Instrumentation
CONFIG_KGDB=n
CONFIG_KGDB_SERIAL_CONSOLE=n
CONFIG_KGDB_TESTS=n
CONFIG_KGDB_LOW_LEVEL_TRAP=n
CONFIG_KGDB_KDB=n
CONFIG_KDB=n
CONFIG_KDB_KEYBOARD=n
CONFIG_KDB_CONTINUE_CATASTROPHIC=n
CONFIG_DEBUG_KERNEL=n

# Lock Debugging
CONFIG_PROVE_LOCKING=n
CONFIG_LOCK_STAT=n
CONFIG_DEBUG_LOCKDEP=n
CONFIG_DEBUG_LOCKDEP_INIT=n

# Memory Debugging
CONFIG_PAGE_OWNER=n
CONFIG_PAGE_POISONING=n
CONFIG_SLUB_DEBUG=n
CONFIG_SLUB_DEBUG_ON=n
CONFIG_SLUB_STATS=n
CONFIG_SLAB_FREELIST_RANDOM=n
CONFIG_SLAB_FREELIST_HARDENED=n
CONFIG_SLAB_RED_ZONE=n
CONFIG_SLAB=n

# Miscellaneous
CONFIG_LATENCYTOP=n
CONFIG_SCHEDSTATS=n
CONFIG_TIMER_STATS=n
CONFIG_BOOT_PRINTK_DELAY=n
CONFIG_PANIC_ON_OOPS=n
CONFIG_PANIC_ON_WARN=n
CONFIG_PANIC_ON_BUG=n
CONFIG_PANIC_ON_TIMEOUT=n
CONFIG_PANIC_ON_SOFTLOCKUP=n
CONFIG_PANIC_ON_HARDLOCKUP=n
CONFIG_PANIC_ON_NMI=n
CONFIG_PANIC_ON_OOM=n
CONFIG_PANIC_ON_KILL=n
CONFIG_PANIC_ON_REBOOT=n
CONFIG_PANIC_ON_SHUTDOWN=n
CONFIG_PANIC_ON_RESUME=n
CONFIG_PANIC_ON_SUSPEND=n
CONFIG_PANIC_ON_HIBERNATE=n
CONFIG_PANIC_ON_CRASH=n
CONFIG_PANIC_ON_HALT=n
CONFIG_PANIC_ON_STOP=n
CONFIG_PANIC_ON_PAUSE=n
CONFIG_PANIC_ON_RESUME=n
CONFIG_PANIC_ON_SUSPEND=n
CONFIG_PANIC_ON_HIBERNATE=n
CONFIG_PANIC_ON_CRASH=n
CONFIG_PANIC_ON_HALT=n
CONFIG_PANIC_ON_STOP=n
CONFIG_PANIC_ON_PAUSE=n

# Staging & Experimental
CONFIG_STAGING=n
CONFIG_ANDROID_INTF_ALARM_DEV=n
CONFIG_ION=n
CONFIG_ANDROID_BINDER_DEVICES=n
CONFIG_ANDROID_LOGGER=n
CONFIG_ANDROID_TIMED_OUTPUT=n
CONFIG_ANDROID_LOW_MEMORY_KILLER=n
CONFIG_ANDROID_VSOC=n
CONFIG_ANDROID_PARANOID_NETWORK=n
CONFIG_ANDROID_EMULATOR=n
CONFIG_ANDROID=n

# Crash Dump & Logging
CONFIG_PSTORE=n
CONFIG_PSTORE_RAM=n
CONFIG_PSTORE_CONSOLE=n
CONFIG_PSTORE_PMSG=n
CONFIG_PSTORE_FTRACE=n
CONFIG_PSTORE_ZONE=n
CONFIG_PSTORE_BLK=n

# Static Analysis & Sanitizers
CONFIG_KASAN=n
CONFIG_UBSAN=n
CONFIG_KCSAN=n
CONFIG_KMSAN=n
CONFIG_KUNIT=n
CONFIG_KUNIT_TEST=n
CONFIG_KUNIT_DEBUGFS=n
CONFIG_KUNIT_EXAMPLE_TEST=n
CONFIG_KUNIT_EXAMPLE=n
CONFIG_KUNIT_EXAMPLE_TEST=n
CONFIG_KUNIT_EXAMPLE=n

# Mediatek Specific Debug Tracers
CONFIG_MTK_DEBUG_TRACER=n
CONFIG_MTK_BUS_TRACER=n
CONFIG_MTK_MCSI_B_TRACER=n
###
CONFIG_BRIDGE=n
CONFIG_BRIDGE_IGMP_SNOOPING=n
CONFIG_BSD_PROCESS_ACCT=n
CONFIG_COREDUMP=n
CONFIG_ELFCORE=n
CONFIG_NF_CONNTRACK_AMANDA=n
CONFIG_NF_CONNTRACK_H323=n
CONFIG_NF_CONNTRACK_IRC=n
CONFIG_NF_CONNTRACK_NETBIOS_NS=n
CONFIG_NF_CONNTRACK_PPTP=n
CONFIG_NF_CONNTRACK_SANE=n
CONFIG_NF_CONNTRACK_TFTP=n
CONFIG_NF_NAT_AMANDA=n
CONFIG_NF_NAT_FTP=n
CONFIG_NF_NAT_IRC=n
CONFIG_NF_NAT_TFTP=n
CONFIG_NF_NAT_PPTP=n
CONFIG_NF_NAT_H323=n
CONFIG_IP_SCTP=n
CONFIG_INET_SCTP_DIAG=n
CONFIG_NET_ACT_POLICE=n
CONFIG_NET_ACT_IPT=n
CONFIG_NET_CLS_FW=n
CONFIG_NET_CLS_U32=n
CONFIG_NET_CLS_FLOW=n
CONFIG_NET_SCH_HTB=n
CONFIG_SCTP_DEFAULT_COOKIE_HMAC_MD5=n
CONFIG_SCTP_COOKIE_HMAC_MD5=n
CONFIG_STP=n
# END Modules not needed

# Magnetometer sensors TESTING
# GENERAL SENSOR CONFIGS THAT ARE ALREADY SETUP ABOVE:
# CONFIG_CUSTOM_KERNEL_MAGNETOMETER=y
# CONFIG_MTK_MAGHUB=y
# CONFIG_CUSTOM_KERNEL_UNCALI_MAG_SENSOR=y
# CONFIG_MTK_UNCALI_MAGHUB=y
# GENERAL SENSOR CONFIGS
# CONFIG_IIO_BUFFER=y
# CONFIG_IIO_ST_SENSORS_COMMON=y
# CONFIG_IIO_TRIGGERED_BUFFER=y
# CONFIG_MTK_AUTO_DETECT_MAGNETOMETER=
# CONFIG_IIO_ST_SENSORS_CORE=y
# CONFIG_IIO_ST_MAGN_SPI_3AXIS=y
# CONFIG_IIO_ST_SENSORS_I2C=y
# CONFIG_IIO_ST_SENSORS_SPI=y
# CONFIG_IIO_ST_MAGN_3AXIS=y
# CONFIG_IIO_ST_MAGN_I2C_3AXIS=y
# NO MAGNETOMETER / COMPASS OPTION SO FAR WORKED - Very likely that Magnometer doesn't need further enabling
# TESTING NEW ONE:
# Magnetometer options that DO NOT MAKE COMPASS WORK (ALREADY TRIED)
# CONFIG_MTK_AKM09915_NEW=y
# CONFIG_MTK_AKM09911=y
# CONFIG_MTK_AKM09918=y
# CONFIG_I2C=y
# CONFIG_REGMAP_I2C=y
# CONFIG_SPI=y
# CONFIG_REGMAP_SPI=y
# CONFIG_GPIOLIB=y
# CONFIG_AK8974=n
# CONFIG_AK8975=n
# CONFIG_BMC150_MAGN=y
# CONFIG_BMC150_MAGN_I2C=y
# CONFIG_BMC150_MAGN_SPI=y
# CONFIG_MAG3110=y
# CONFIG_MMC35240=y
# CONFIG_SENSORS_HMC5843_SPI=y
# CONFIG_SENSORS_HMC5843=y
# CONFIG_SENSORS_HMC5843_I2C=y
# CONFIG_IRQ_SBALANCE=y
# CONFIG_IRQ_SBALANCE_POLL_MSEC=3000
# CONFIG_IRQ_SBALANCE_THRESH=1024
# CONFIG_SBALANCE_EXCLUDE_CPUS="5,7"
# CONFIG_IKHEADERS=y
```
